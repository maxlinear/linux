## drivers/net/datapath/datapath_wa/Kconfig
```kconfig
# SPDX-License-Identifier: GPL-2.0

config MXL_DPM_OMCI_PRIORITIZATION
	bool "Enable OMCI traffic prioritization"
```

## drivers/net/datapath/qos_tc/Kconfig
```kconfig
# SPDX-License-Identifier: GPL-2.0

config QOS_TC
	tristate "QoS TC driver"
	depends on DPM_DATAPATH && !GRX500_CBM
	select NET_SCH_RED
	select NET_ACT_COLMARK if !(MXL_SOC_TPZ_MACSS || MXL_TPZ_QEMU)
	select NET_CLS_IND

	help
	  This driver provides user space API for configuring HW QoS over TC
	  resources as schedulers, queues etc. The interface is based on linux
	  tc offload interface. The Intel datapath driver is used to do the
	  actual hardware configuration.

config QOS_TC_KCOV
	bool "QoS TC KCOV"
	depends on KCOV && QOS_TC
	help
	  Enable coverage on QoS TC driver for fuzzing.

config QOS_TC_SWITCH_OFFLOAD
	bool "QoS TC switch offload support"
	depends on QOS_TC
	default y
	help
	  Enable hardware offload for classifier actions that rely on the
	  switch PCE engine: trap-to-CPU, port mirroring/redirect, IP-based
	  drop, SKB priority remark, and DSCP/PCP-to-traffic-class mapping.
	  Disable this on platforms such as Topaz that do not have an
	  integrated switch and where the switch API is not available.

config QOS_TC_TRACING
	bool "QoS TC tracing support"
	depends on QOS_TC
	depends on EVENT_TRACING
	help
	  Select this to enable qos_tc tracing infrastructure.
```

## drivers/net/ethernet/mxl/Kconfig
```kconfig
#
# MaxLinear network device configuration
#

config NET_VENDOR_MXL
	bool "MaxLinear devices"
	default y
	help
	  If you have a network (Ethernet) card belonging to this class, say Y.

	  Note that the answer to this question doesn't directly affect the
	  kernel: saying N will just cause the configurator to skip all
	  the questions about Intel cards. If you say Y, you will be asked for
	  your specific card in the following questions.

if NET_VENDOR_MXL

config MXL_ETH
	tristate "MaxLinear Ethernet driver for GRX500/PRX300/LGM series"
	depends on (MXL_CBM || MXL_DATAPATH)
	select PHYLINK
	select SFP
	help
	Maxlinear Ethernet driver

if MXL_ETH

config MXL_ETH_THERMAL
	bool "ThermaL support for MaxLinear Ethernet driver"
	depends on MXL_ETH && THERMAL
	help
	Thermal support for the MaxLinear Ethernet driver

endif #MXL_ETH

endif # NET_VENDOR_MXL
```
